/*
 * Copyright (c) 2020 Ryan Cross
 *
 * SPDX-License-Identifier: MIT
 *
 * This overlay is used when the left half is configured as a BLE peripheral
 * in dongle mode (3-way split). The hardware configuration is the same as
 * sofle_left.overlay; the peripheral role is determined by Kconfig.defconfig
 * (SHIELD_SOFLE_LEFT_PERIPHERAL does not set ZMK_SPLIT_ROLE_CENTRAL).
 */

#include "sofle.dtsi"

&kscan0 {
    col-gpios
        = <&pro_micro 19 GPIO_ACTIVE_HIGH>
        , <&pro_micro 18 GPIO_ACTIVE_HIGH>
        , <&pro_micro 15 GPIO_ACTIVE_HIGH>
        , <&pro_micro 14 GPIO_ACTIVE_HIGH>
        , <&pro_micro 16 GPIO_ACTIVE_HIGH>
        , <&pro_micro 10 GPIO_ACTIVE_HIGH>
        ;
};

&left_encoder {
    status = "okay";
};
