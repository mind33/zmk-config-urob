#define CONFIG_WIRELESS
#define ZMK_BASE_LAYER(name, LT, RT, LM, RM, LB, RB, LH, RH)                   \
    ZMK_LAYER(                                                                   \
        name,                                                                    \
        &kp GRAVE &kp N1 &kp N2 &kp N3 &kp N4 &kp N5 &kp N6 &kp N7 &kp N8 &kp N9 &kp N0 &kp MINUS \
        &kp TAB   LT                                   RT            &kp BSPC   \
        &kp ESC   LM                                   RM            &kp SQT    \
        &kp LSHFT LB &kp C_MUTE &kp C_MUTE             RB            &kp RSHFT  \
        &kp LALT &kp LGUI &none LH RH &smart_mouse &kp RGUI &kp RALT            \
        ,                                                                        \
        &inc_dec_kp C_VOL_UP C_VOL_DN &inc_dec_kp PG_DN PG_UP                   \
    )

#include "zmk-helpers/key-labels/sofle.h"
#include "base.keymap"
