## config/Kconfig.defconfig
```kconfig
# Copyright (c) 2020 The ZMK Contributors
# SPDX-License-Identifier: MIT

if SHIELD_sofle_DONGLE

config ZMK_KEYBOARD_NAME
	default "sofle Dongle"
	
config ZMK_SPLIT_BLE_ROLE_CENTRAL
	default y
	
config ZMK_USB
	default y

endif

if SHIELD_SOFLE_LEFT || SHIELD_SOFLE_RIGHT || SHIELD_SOFLE_DONGLE 

config ZMK_SPLIT
	default y

config ZMK_BLE
	default y
	
endif
```

## config/boards/shields/nice_nano_v2_dongle/Kconfig.defconfig
```kconfig
if SHIELD_NICE_NANO_V2_DONGLE

config ZMK_KEYBOARD_NAME
    default "Sofle Dongle"

config ZMK_SPLIT_ROLE_CENTRAL
    default y

config ZMK_SPLIT
    default y

# Two peripherals: left and right Sofle halves.
config ZMK_SPLIT_BLE_CENTRAL_PERIPHERALS
    default 2

# BT_MAX_CONN = peripherals (2) + desired BT profiles (5) = 7
config BT_MAX_CONN
    default 7

config BT_MAX_PAIRED
    default 7

endif # SHIELD_NICE_NANO_V2_DONGLE
```

## config/boards/shields/nice_nano_v2_dongle/Kconfig.shield
```kconfig
config SHIELD_NICE_NANO_V2_DONGLE
    def_bool $(shields_list_contains,nice_nano_v2_dongle)
```

## config/boards/shields/sofle/Kconfig.defconfig
```kconfig
if SHIELD_CORNE_CENTRAL_DONGLE

config ZMK_KEYBOARD_NAME
    default "sofle"

config ZMK_SPLIT_ROLE_CENTRAL
    default y

endif

if SHIELD_SOFLE_CENTRAL_DONGLE || SHIELD_SOFLE_LEFT || SHIELD_SOFLE_RIGHT

config ZMK_SPLIT
    default y

endif
```

## config/boards/shields/sofle/Kconfig.shield
```kconfig
# Copyright (c) 2020 Pete Johanson
# SPDX-License-Identifier: MIT

config SHIELD_CORNE_CENTRAL_DONGLE
    def_bool $(shields_list_contains,sofle_central_dongle)

config SHIELD_CORNE_PERIPHERAL_LEFT
    def_bool $(shields_list_contains,sofle_left)

config SHIELD_CORNE_PERIPHERAL_RIGHT
    def_bool $(shields_list_contains,sofle_right)
```

## config/boards/shields/sofle_dongle_helper/Kconfig.shield
```kconfig
config SHIELD_SOFLE_DONGLE_HELPER
    def_bool $(shields_list_contains,sofle_dongle_helper)
```

## config/west.yml
```yaml
manifest:
  projects:
    - name: zephyr
      import:
        name-allowlist:
          - cmsis
          - hal_nordic
          - hal_rpi_pico
          - hal_stm32
          - mbedtls
          - tinycrypt
          - nanopb
# Additional comments and configurations can remain unchanged.
```
