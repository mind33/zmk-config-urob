/*
 * Keymap for the nice!nano v2 USB dongle.
 *
 * The dongle acts as the BLE central for both Sofle halves and forwards all
 * input to the PC over USB.  It is intentionally identical to sofle.keymap
 * except that CONFIG_WIRELESS is NOT defined, so the Bluetooth-selection
 * keys in the SYS layer are replaced with transparent stubs (the dongle
 * always outputs over USB and never advertises to a BLE host).
 */

#define ZMK_BASE_LAYER(name, LT, RT, LM, RM, LB, RB, LH, RH)                          \
    ZMK_LAYER(                                                                          \
        name,                                                                           \
        &kp GRAVE &kp N1  &kp N2  &kp N3  &kp N4  &kp N5                              \
        &kp N6    &kp N7  &kp N8  &kp N9  &kp N0  &kp MINUS                           \
        &kp TAB   LT                                       RT   &kp BSPC               \
        &kp LCTRL LM                                       RM   &kp SQT                \
        &kp LSHFT LB             &kp C_MUTE   &kp C_PP    RB   &kp RSHFT              \
        &kp LCTRL &kp LALT LH                         RH  &kp RALT &smart_mouse        \
    )

#include "zmk-helpers/key-labels/sofle.h"
#include "base.keymap"
